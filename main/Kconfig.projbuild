## main/Kconfig.projbuild
```kconfig
menu "Efflorescence"

    config APP_TOUCH_GND_GPIO
        int "GPIO that grounds the touch sensor (driven low), -1 for none"
        default 3

    config APP_TOUCH_IO_GPIO
        int "Touch sensor output GPIO (high when touched)"
        default 4

    config APP_TOUCH_VCC_GPIO
        int "GPIO that powers the touch sensor (driven high), -1 for none"
        default 5

    config APP_LED_GND_GPIO
        int "GPIO that grounds the LED driver input (driven low), -1 for none"
        default 6

    config APP_LED_PWM_GPIO
        int "LED driver PWM GPIO (high = LED on)"
        default 7

    config APP_PWM_FREQ_HZ
        int "LED PWM frequency, Hz"
        default 1250

    config APP_PWM_BITS
        int "LED PWM resolution, bits"
        range 8 14
        default 14

    config APP_LED_DUTY_MIN_PERMILLE
        int "PWM duty of the dimmest steady light, per mille"
        range 0 500
        default 29
        help
            Brightness 1 % is this duty. Below it the pulses are shorter
            than the optocoupler's edges and the light flickers; a fade
            crosses that stretch quickly and the lamp never rests there.
            29 is what the owner found by eye to be the lowest steady
            light on this lamp at 1250 Hz.

    config APP_WIFI_LISTEN_INTERVAL
        int "Listen to every Nth beacon of the access point"
        range 1 10
        default 3
        help
            1 hears every beacon and with it every broadcast: the lamp
            answers ARP and mDNS at once. More saves power and makes the
            lamp slower, and now and then deaf, to those. Measured with
            the lamp off: the radio is awake 11 % of the time at 1 and
            7 % at 3.

    config APP_UPDATE_URL
        string "Update manifest URL"
        default "https://grakovne.github.io/efflorescence/ota.json"

endmenu
```
